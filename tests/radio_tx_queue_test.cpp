#include <atomic>
#include <cassert>
#include <cstdint>
#include <iostream>
#include <mutex>
#include <queue>
#include <thread>
#include <utility>
#include <vector>

// Host doubles for the queue handoff; no RF or timer timing is simulated.
using SemaphoreHandle_t = std::mutex*;
constexpr unsigned portMAX_DELAY = ~0u;
thread_local unsigned lockDepth = 0;
void xSemaphoreTake(SemaphoreHandle_t mutex, unsigned) {
    mutex->lock();
    ++lockDepth;
}
void xSemaphoreGive(SemaphoreHandle_t mutex) {
    --lockDepth;
    mutex->unlock();
}
template<class... Args> void ets_printf(const char*, Args...) {
    assert(lockDepth == 0);
}
void setCrashMarker(const char*) { assert(lockDepth == 0); }
uint32_t millis() { return 10; }
uint64_t esp_timer_get_time() { return 10000; }
constexpr unsigned TWOW_SCAN_INTERVAL_US = 2700;
constexpr unsigned LONG_PREAMBLE_MS = 1920;
constexpr unsigned REG_FIFO = 0;

struct iohcPacket {
    int producer;
    int sequence;
    uint32_t frequency = 868950000;
    uint8_t repeat = 4;
    uint32_t repeatTime = 40;
    unsigned buffer_length = 1;
    struct {
        unsigned char buffer[1]{};
        struct {
            struct {
                struct { struct { unsigned Protocol = 1; } asStruct; } CtrlByte1;
                uint8_t cmd = 0;
            } header;
        } packet;
    } payload;
};
bool shouldStartTwoWListenAfterTx(const iohcPacket*) { return false; }
uint16_t transmitPreambleBytes(const iohcPacket*) { return 1920; }

namespace Radio {
enum class Carrier { Frequency };
void setPreambleLength(uint16_t) { assert(lockDepth == 0); }
void setStandby() { assert(lockDepth == 0); }
void setCarrier(Carrier, uint32_t) { assert(lockDepth == 0); }
void clearFlags() { assert(lockDepth == 0); }
void writeBytes(unsigned, const unsigned char*, unsigned) { assert(lockDepth == 0); }
void setTx() { assert(lockDepth == 0); }
}

namespace IOHC {
std::atomic<uint8_t> lastSendCmd{0};
class iohcRadio {
public:
    enum class RadioState { RX, TX };
    inline static std::atomic<RadioState> radioState{RadioState::RX};
    inline static std::atomic<bool> txBatchActive{false};
    bool txComplete = false;
    std::mutex mutex;
    SemaphoreHandle_t sendQueueMutex = &mutex;
    std::queue<std::vector<iohcPacket*>> sendQueue;
    std::vector<iohcPacket*> packets2send;
    unsigned txCounter = 0;
    bool twoWScanActive = false, resumeTwoWScanAfterTx = false, currentBatchHas2W = false;
    uint32_t twoWScanUntilMs = 0, resumeTwoWScanUntilMs = 0, resumeTwoWScanWindowMs = 0;
    uint32_t scanTimeUs = 13520, resumeTwoWScanDwellUs = 0;
    uint64_t txStartedAtUs = 0;
    struct SenderDouble {
        std::atomic<bool> ready{false};
        unsigned starts = 0;
        void attach_ms(unsigned interval, void (*)(void*), void*) {
            assert(lockDepth == 0);
            assert(interval == 40);
            ++starts;
            ready.store(true);
        }
    } Sender;
    static void onTxTicker(void*) {}
    static void setRadioState(RadioState state) { radioState = state; }
    void queueSend(std::vector<iohcPacket*>&);
    void startQueuedSend();
    void send(std::vector<iohcPacket*>&);

    // Finish a batch without implementing the real radio timer callback.
    void finish(std::vector<std::pair<int, int>>& received) {
        assert(Sender.ready.exchange(false));
        assert(txBatchActive);
        radioState = RadioState::RX;
        std::this_thread::yield();
        for (auto* packet : packets2send) {
            received.emplace_back(packet->producer, packet->sequence);
            delete packet;
        }
        packets2send.clear();
        txBatchActive = false;
        startQueuedSend();
    }
};

// Generated by the runner from the actual firmware, not a copied algorithm.
#include "radio_tx_methods.inc"
}

int main() {
    using IOHC::iohcRadio;
    {
        iohcRadio radio;
        std::vector<iohcPacket*> empty;
        radio.send(empty);
        assert(radio.Sender.starts == 0);
        std::vector<iohcPacket*> first{new iohcPacket{0, 0}};
        std::vector<iohcPacket*> second{new iohcPacket{0, 1}};
        radio.send(first);
        radio.send(second);
        assert(first.empty() && second.empty());
        assert(radio.Sender.starts == 1 && radio.sendQueue.size() == 1);
        std::vector<std::pair<int, int>> received;
        radio.finish(received);
        assert(radio.Sender.starts == 2);
        radio.finish(received);
        assert((received == std::vector<std::pair<int, int>>{{0, 0}, {0, 1}}));
        assert(!radio.txBatchActive && radio.sendQueue.empty());
        assert(radio.mutex.try_lock());
        radio.mutex.unlock();
    }
    {
        iohcRadio radio;
        constexpr int producers = 4, batches = 1000, batchSize = 2;
        std::vector<std::pair<int, int>> received;
        std::thread consumer([&] {
            while (received.size() < producers * batches * batchSize) {
                if (radio.Sender.ready.load()) radio.finish(received);
                else std::this_thread::yield();
            }
        });
        std::vector<std::thread> workers;
        for (int producer = 0; producer < producers; ++producer) {
            workers.emplace_back([&, producer] {
                for (int batch = 0; batch < batches; ++batch) {
                    std::vector<iohcPacket*> packets;
                    for (int item = 0; item < batchSize; ++item)
                        packets.push_back(new iohcPacket{producer, batch * batchSize + item});
                    radio.send(packets);
                    assert(packets.empty());
                }
            });
        }
        for (auto& worker : workers) worker.join();
        consumer.join();
        int next[producers]{};
        for (const auto& entry : received) {
            assert(entry.second == next[entry.first]++);
        }
        for (int count : next) assert(count == batches * batchSize);
        assert(radio.Sender.starts == producers * batches);
        assert(radio.sendQueue.empty() && radio.packets2send.empty());
        assert(!radio.txBatchActive);
    }
    std::cout << "PASS: two commands, empty queue, concurrent producers, FIFO per producer, "
                 "8000 packets, no duplicate starts, no IO under the queue lock\n";
}
